## firmware/boards/nordic/cadence_rft/board.yml
```yaml
# Copyright (c) 2026
# SPDX-License-Identifier: Apache-2.0

board:
  name: cadence_rft
  full_name: Cadence sensor on RideFormTracker PCB v1.1 (MDBT50Q / nRF52840)
  vendor: nordic
  socs:
    - name: nrf52840
```

## firmware/boards/nordic/cadence_v1/Kconfig.cadence_v1
```kconfig
# Copyright (c) 2026
# SPDX-License-Identifier: Apache-2.0

config BOARD_CADENCE_V1
	select SOC_NRF52840_QIAA
```

## firmware/boards/nordic/cadence_v1/board.yml
```yaml
# Copyright (c) 2026
# SPDX-License-Identifier: Apache-2.0

board:
  name: cadence_v1
  full_name: Cadence sensor PCB v1 (KiCad/BikeSensor, MDBT50Q / nRF52840)
  vendor: nordic
  socs:
    - name: nrf52840
```
